// SPDX-License-Identifier: GPL-2.0+ OR MIT
/*
 * J714c apcie0 and pci-bridge0 tunables, copied unchanged from this machine's ADT
 * (2026-11-05) as (offset, 4, mask, value): what m1n1 copies on chips it knows and
 * the kernel applies when it trains the N1's port itself. cio3pllcore offsets are
 * relative to pcieclkgen (+0x2200, the T8140 layout).
 */
&pcie0 {
	apple,tunable-axi2af =
			<0x0 4 0x800000ff 0x80000022>,
			<0x4 4 0x80ff00ff 0x80220002>,
			<0x8 4 0x80ff00ff 0x80220002>,
			<0xc 4 0x80ff00ff 0x80220002>,
			<0x10 4 0x80ff00ff 0x80220002>,
			<0x14 4 0x80ff00ff 0x80220002>,
			<0x18 4 0x80ff00ff 0x80220002>,
			<0x1c 4 0x800000ff 0x80000019>,
			<0x20 4 0x800000ff 0x80000088>,
			<0x24 4 0x80ff00ff 0x80880008>,
			<0x28 4 0x80ff00ff 0x80880008>,
			<0x2c 4 0x80ff00ff 0x80880008>,
			<0x30 4 0x80ff00ff 0x80880008>,
			<0x34 4 0x800000ff 0x80000019>,
			<0x38 4 0x800000ff 0x80000019>,
			<0x3c 4 0x800000ff 0x8000001c>,
			<0x100 4 0xff 0xff>,
			<0x104 4 0x3 0x3>,
			<0x108 4 0xffff0007 0x100001>,
			<0x300 4 0x3 0x1>,
			<0x304 4 0x3f3f0000 0x8080000>,
			<0x308 4 0x3ff 0xd>,
			<0x30c 4 0x700003ff 0xc>,
			<0x310 4 0x80001f 0x800001>,
			<0x314 4 0x8080001f 0x80800001>,
			<0x318 4 0x80001f 0x800003>,
			<0x31c 4 0x8080001f 0x80800003>,
			<0x320 4 0x80001f 0x800003>,
			<0x324 4 0x8080001f 0x80800003>,
			<0x328 4 0x80001f 0x800003>,
			<0x32c 4 0x80001f 0x800003>,
			<0x330 4 0x80001f 0x800003>,
			<0x334 4 0x80001f 0x800003>,
			<0x338 4 0x80001f 0x800003>,
			<0x33c 4 0x80001f 0x800003>,
			<0x340 4 0x80001f 0x800003>,
			<0x404 4 0xffff0023 0x1c0021>,
			<0x408 4 0x3ff 0xd>,
			<0x40c 4 0x700003ff 0xc>,
			<0x410 4 0x8000001f 0x80000001>,
			<0x414 4 0x8000001f 0x80000001>,
			<0x418 4 0x8000001f 0x80000003>,
			<0x41c 4 0x8000001f 0x80000003>,
			<0x420 4 0x8000001f 0x80000003>,
			<0x424 4 0x8000001f 0x80000003>,
			<0x428 4 0x8000001f 0x80000003>,
			<0x42c 4 0x8000001f 0x80000003>,
			<0x430 4 0x8000001f 0x80000003>,
			<0x434 4 0x8000001f 0x80000003>,
			<0x438 4 0x8000001f 0x80000003>,
			<0x43c 4 0x8000001f 0x80000003>,
			<0x440 4 0x8000001f 0x80000003>,
			<0x948 4 0x7ff07ff 0x200000>,
			<0xa48 4 0x7ff07ff 0x100>,
			<0xb00 4 0x20000000 0x20000000>,
			<0xb48 4 0x7ff07ff 0x800080>,
			<0xe00 4 0xffffffff 0x7fffffff>,
			<0xe04 4 0x100 0x100>,
			<0x4008 4 0x1 0x1>,
			<0x400c 4 0x1 0x1>,
			<0x4014 4 0x1 0x0>,
			<0x4018 4 0x1 0x0>,
			<0x401c 4 0x1 0x1>,
			<0x10f8 4 0x1 0x1>,
			<0x11f8 4 0x1 0x1>,
			<0x12f8 4 0x1 0x1>,
			<0x13f8 4 0x1 0x1>,
			<0x14f8 4 0x1 0x1>,
			<0x10fc 4 0x1 0x1>,
			<0x11fc 4 0x1 0x1>,
			<0x12fc 4 0x1 0x1>,
			<0x13fc 4 0x1 0x1>,
			<0x14fc 4 0x1 0x1>,
			<0x20028 4 0xfc2f 0x0>,
			<0x2002c 4 0x7 0x0>,
			<0x20030 4 0xff 0x0>,
			<0x20034 4 0x3ff 0x0>,
			<0x20058 4 0x30b 0x0>;
	apple,tunable-cio3pllcore = /* at pcieclkgen + 0x2200 */
			<0x2200 4 0xa0b 0xa01>,
			<0x2224 4 0xc00 0x800>,
			<0x2228 4 0xf00 0xb00>,
			<0x2238 4 0x20 0x0>,
			<0x224c 4 0xff 0x95>,
			<0x22e8 4 0xe0000 0x20000>,
			<0x2300 4 0xffffff 0xb40b4>;
	apple,tunable-pcieclkgen =
			<0x0 4 0x3e0 0x220>;
	apple,tunable-phy =
			<0x20000 4 0x4000000 0x0>,
			<0x10000 4 0x10000000 0x0>,
			<0x14000 4 0x10000000 0x0>,
			<0x18000 4 0x10000000 0x0>,
			<0x1c000 4 0x10000000 0x0>;
	apple,tunable-phy-ip-pll =
			<0x180828 4 0xffff 0xb44>,
			<0x180838 4 0x2 0x2>,
			<0x180c1c 4 0x7e0 0x7c0>,
			<0x180e10 4 0x3e0 0x280>,
			<0x1820a4 4 0x3c3c000 0x1010000>,
			<0x182200 4 0x8 0x8>,
			<0x18221c 4 0x7c0 0x500>,
			<0x182224 4 0xc00 0x800>,
			<0x182228 4 0xf00 0xb00>,
			<0x182230 4 0x3f 0x34>,
			<0x18224c 4 0xfe7f 0x4412>,
			<0x1822b0 4 0x700000 0x300000>,
			<0x182338 4 0x1f00 0x1700>,
			<0x183000 4 0x301fbf00 0x1e3400>,
			<0x183004 4 0x1fffff 0x8cf39>,
			<0x183014 4 0xff0000ff 0x40000080>,
			<0x183008 4 0x1fffff 0x15930a>,
			<0x18300c 4 0x1fffff 0x1a2548>,
			<0x183010 4 0x1fffff 0x1baaa8>;
	apple,tunable-phy-ip-auspma =
			<0x184008 4 0xffffffff 0xb>,
			<0x190008 4 0xffffffff 0xb>,
			<0x19c008 4 0xffffffff 0xb>,
			<0x1a8008 4 0xffffffff 0xb>,
			<0x1860c8 4 0xff 0x0>,
			<0x1920c8 4 0xff 0x0>,
			<0x19e0c8 4 0xff 0x0>,
			<0x1aa0c8 4 0xff 0x0>,
			<0x1884c0 4 0x43f0 0x4150>,
			<0x188574 4 0x7f8000 0x0>,
			<0x1944c0 4 0x43f0 0x4150>,
			<0x194574 4 0x7f8000 0x0>,
			<0x1a04c0 4 0x43f0 0x4150>,
			<0x1a0574 4 0x7f8000 0x0>,
			<0x1ac4c0 4 0x43f0 0x4150>,
			<0x1ac574 4 0x7f8000 0x0>,
			<0x189814 4 0x7e00 0xc00>,
			<0x189838 4 0xfe00000 0x5e00000>,
			<0x1898b4 4 0x3f000000 0xa000000>,
			<0x195814 4 0x7e00 0xc00>,
			<0x195838 4 0xfe00000 0x5e00000>,
			<0x1958b4 4 0x3f000000 0xa000000>,
			<0x1a1814 4 0x7e00 0xc00>,
			<0x1a1838 4 0xfe00000 0x5e00000>,
			<0x1a18b4 4 0x3f000000 0xa000000>,
			<0x1ad814 4 0x7e00 0xc00>,
			<0x1ad838 4 0xfe00000 0x5e00000>,
			<0x1ad8b4 4 0x3f000000 0xa000000>,
			<0x18a050 4 0x8000000 0x8000000>,
			<0x18a140 4 0xffff 0x7d0>,
			<0x18a154 4 0x1f00 0x1c00>,
			<0x18a2c0 4 0x1f803f 0x10008>,
			<0x18a2c8 4 0x1f803f 0x20011>,
			<0x18a2d0 4 0x3f 0x22>,
			<0x18a31c 4 0xf0ff0f0 0x7071010>,
			<0x18a338 4 0xffff 0xa0a>,
			<0x18a33c 4 0x7f0f 0x2408>,
			<0x18a340 4 0xf 0x8>,
			<0x18a378 4 0xff00 0x600>,
			<0x18a37c 4 0xff00 0x600>,
			<0x18a380 4 0xff00 0xf00>,
			<0x18a384 4 0xff00 0xf00>,
			<0x18a3b8 4 0xffffffff 0x85e000>,
			<0x18a3c8 4 0xffffffff 0x300>,
			<0x196050 4 0x8000000 0x8000000>,
			<0x196140 4 0xffff 0x7d0>,
			<0x196154 4 0x1f00 0x1c00>,
			<0x1962c0 4 0x1f803f 0x10008>,
			<0x1962c8 4 0x1f803f 0x20011>,
			<0x1962d0 4 0x3f 0x22>,
			<0x19631c 4 0xf0ff0f0 0x7071010>,
			<0x196338 4 0xffff 0xa0a>,
			<0x19633c 4 0x7f0f 0x2408>,
			<0x196340 4 0xf 0x8>,
			<0x196378 4 0xff00 0x600>,
			<0x19637c 4 0xff00 0x600>,
			<0x196380 4 0xff00 0xf00>,
			<0x196384 4 0xff00 0xf00>,
			<0x1963b8 4 0xffffffff 0x85e000>,
			<0x1963c8 4 0xffffffff 0x300>,
			<0x1a2050 4 0x8000000 0x8000000>,
			<0x1a2140 4 0xffff 0x7d0>,
			<0x1a2154 4 0x1f00 0x1c00>,
			<0x1a22c0 4 0x1f803f 0x10008>,
			<0x1a22c8 4 0x1f803f 0x20011>,
			<0x1a22d0 4 0x3f 0x22>,
			<0x1a231c 4 0xf0ff0f0 0x7071010>,
			<0x1a2338 4 0xffff 0xa0a>,
			<0x1a233c 4 0x7f0f 0x2408>,
			<0x1a2340 4 0xf 0x8>,
			<0x1a2378 4 0xff00 0x600>,
			<0x1a237c 4 0xff00 0x600>,
			<0x1a2380 4 0xff00 0xf00>,
			<0x1a2384 4 0xff00 0xf00>,
			<0x1a23b8 4 0xffffffff 0x85e000>,
			<0x1a23c8 4 0xffffffff 0x300>,
			<0x1ae050 4 0x8000000 0x8000000>,
			<0x1ae140 4 0xffff 0x7d0>,
			<0x1ae154 4 0x1f00 0x1c00>,
			<0x1ae2c0 4 0x1f803f 0x10008>,
			<0x1ae2c8 4 0x1f803f 0x20011>,
			<0x1ae2d0 4 0x3f 0x22>,
			<0x1ae31c 4 0xf0ff0f0 0x7071010>,
			<0x1ae338 4 0xffff 0xa0a>,
			<0x1ae33c 4 0x7f0f 0x2408>,
			<0x1ae340 4 0xf 0x8>,
			<0x1ae378 4 0xff00 0x600>,
			<0x1ae37c 4 0xff00 0x600>,
			<0x1ae380 4 0xff00 0xf00>,
			<0x1ae384 4 0xff00 0xf00>,
			<0x1ae3b8 4 0xffffffff 0x85e000>,
			<0x1ae3c8 4 0xffffffff 0x300>,
			<0x18c410 4 0x100000 0x0>,
			<0x18c438 4 0x1800000 0x0>,
			<0x18c4a4 4 0x10 0x10>,
			<0x198410 4 0x100000 0x0>,
			<0x198438 4 0x1800000 0x0>,
			<0x1984a4 4 0x10 0x10>,
			<0x1a4410 4 0x100000 0x0>,
			<0x1a4438 4 0x1800000 0x0>,
			<0x1a44a4 4 0x10 0x10>,
			<0x1b0410 4 0x100000 0x0>,
			<0x1b0438 4 0x1800000 0x0>,
			<0x1b04a4 4 0x10 0x10>;
};

&port00 {
	apple,apcie-config-tunables =
			<0x140 4 0x1 0x1>,
			<0x144 4 0xffffff 0x253770>,
			<0x8a8 4 0x1 0x1>,
			<0x8ac 4 0x1 0x1>;
	apple,pcie-rc-tunables =
			<0x78 4 0x7000 0x0>,
			<0x194 4 0x2 0x2>,
			<0xb80 4 0x7f3f3f 0x7f1e1e>,
			<0xb88 4 0x7f3f3f 0x7f1e1e>;
	apple,pcie-rc-gen3-shadow-tunables =
			<0x154 4 0xf0f0f0f 0x5050505>,
			<0x890 4 0x3000000 0x0>,
			<0x8a8 4 0xffff0f 0x1>;
	apple,pcie-rc-gen4-shadow-tunables =
			<0x178 4 0xffff 0x5555>,
			<0x890 4 0x3000000 0x1000000>,
			<0x8a8 4 0xffff0f 0x1>;
	apple,pcie-rc-gen5-shadow-tunables =
			<0x1ac 4 0xffff 0x5555>,
			<0x890 4 0x3000000 0x2000000>,
			<0x8a8 4 0xffff0f 0x1>;
};
